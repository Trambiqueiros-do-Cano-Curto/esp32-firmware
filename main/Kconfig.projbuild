## main/Kconfig.projbuild
```kconfig
menu "Wi-Fi Configuration"
    config WIFI_SSID
        string "SSID do Wi-Fi"
        default ""
        help
            Nome da rede Wi-Fi que o ESP32 deve conectar.

    config WIFI_PASSWORD
        string "Senha do Wi-Fi"
        default ""
        help
            Senha da rede Wi-Fi.

endmenu

menu "MQTT Configuration"
    config MQTT_BROKER_URI
        string "MQTT Broker URI"
        default "mqtt://64.181.160.152:1883"
        help
            Endereço do Broker MQTT.

    config MQTT_BROKER_USERNAME
        string "MQTT Broker Username"
        default "tcc"
        help
            Nome de usuário do Broker MQTT.

    config MQTT_BROKER_PASSWORD
        string "MQTT Broker Password"
        default "larsmM"
        help
            Senha do Broker MQTT.
endmenu
```
